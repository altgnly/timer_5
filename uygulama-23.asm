	__CONFIG H'3F31'
	LIST P=16F877A
	#INCLUDE <P16F877A.INC>
	SAYICI EQU 0X20
	ORG 0X000
	GOTO ANA_METOT
	ORG 0X004

KESME_METOT
	BTFSS INTCON,TMR0IF
	RETFIE
	BCF INTCON,TMR0IF

	MOVLW D'6'
	MOVWF TMR0

	DECFSZ SAYICI,F
	RETFIE

	MOVLW D'125'
	MOVWF SAYICI

	RLF PORTD,F

	RETFIE

ANA_METOT
	BANKSEL TRISD
	CLRF TRISD
	BANKSEL PORTD
	CLRF PORTD

	BSF PORTD,0

	BANKSEL INTCON
	MOVLW B'11100000'
	MOVWF INTCON
	BANKSEL INTCON

	BANKSEL OPTION_REG
	MOVLW B'00000011'
	MOVWF OPTION_REG
	BANKSEL OPTION_REG

	BANKSEL TMR0
	MOVLW D'6'
	MOVWF TMR0
	CLRF SAYICI
	MOVLW D'125'	
	MOVWF SAYICI	
	BANKSEL TMR0

KONTROL
	GOTO KONTROL
	
END